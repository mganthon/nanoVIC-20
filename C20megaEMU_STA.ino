#include <EEPROM.h>

#include <avr/io.h>
#include <avr/pgmspace.h>
#include <avr/interrupt.h>
#include <avr/sleep.h>

//----------------- VideoBlaster definitions -----------------

#define DOTCLK 1   // Pixel clock (0 for 8MHz, 1 for 4MHz)
#define HSYNC 132  // Hsync frequency (divided from Fcpu)
#define LINES 261  // Lines per field -1 (261 for NTSC, 311 for PAL)
#define SYNCPIN 4  // Pin in PORTD that rhat is connected for sync
#define INTERLACE 0 // 0 for interlace, 1 for non interlace Running with interlaced video gives more cycles to the application

volatile byte VBE=0;     // Video blanking status. If this is not zero you should sleep to keep the video smooth

#define WAIT_VBE while (VBE==1) sleep_cpu();

unsigned int scanline=0; // Dont touch, not volatile
unsigned int videoptr=0; // Dont touch, not volatile 
byte row;                // Dont touch, not volatile
byte lace;               // Dont touch, not volatile

// This is the video character ROM (8x8 font definition)
const unsigned char charROM [8] [128] PROGMEM = { 0x1C , 0x18 , 0x7C , 0x1C , 0x78 , 0x7E , 0x7E , 0x1C , 0x42 , 0x1C , 0xE , 0x42 , 0x40 ,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 0x0 , 0xF };

#define SYNCDELAY   // This makes up the sync pulse low time delay
    asm("nop\n nop\n nop\n nop\n nop\n nop\n nop\n nop\n"); \
    asm("nop\n nop\n nop\n nop\n nop\n nop\n nop\n nop\n"); \
    asm("nop\n nop\n nop\n nop\n nop\n nop\n nop\n nop\n"); \
    asm("nop\n nop\n nop\n nop\n nop\n nop\n nop\n nop\n"); \
    asm("nop\n nop\n nop\n nop\n nop\n nop\n nop\n nop\n"); \
    asm("nop\n nop\n nop\n nop\n nop\n nop\n nop\n nop\n"); \
    asm("nop\n nop\n nop\n nop\n nop\n nop\n nop\n nop\n"); \
    asm("nop\n nop\n nop\n nop\n nop\n nop\n nop\n nop\n");
    
const byte MSPIM_SCK = 4;  // This is needed for the hardware to work
const byte MSPIM_SS = 5;   // This is needed for the hardware to work

//--------------------------------------------------------------



char videomem[528];
char basicram[512];

uint8_t RAM[832];

extern "C" {
  void exec6502();
  void reset6502();
    
  void writeEEPROM(unsigned int eeaddress, byte data ) {
  if ((eeaddress>7679)&&(eeaddress<8192)) {
    videomem[eeaddress-7680+22]=data;
    return;
  }
  if ((eeaddress>1023)&&(eeaddress<2048)) {
    digitalWrite(13,HIGH);
    EEPROM.write(eeaddress&0x3FF, data);
    digitalWrite(13,LOW);
    return;
  }
  if ((eeaddress>2047)&&(eeaddress<7680)) {
    basicram[eeaddress&0x1FF]=data;
    return;
  }
  return;  
}

  
byte readEEPROM(unsigned int eeaddress ) {
  if ((eeaddress>7679)&&(eeaddress<8192)) {
    return videomem[eeaddress-7680+22];
  }
  if ((eeaddress>1023)&&(eeaddress<2048)) {
    return EEPROM.read(eeaddress&0x3FF);
  }
  if ((eeaddress>2047)&&(eeaddress<7680)) {
    return basicram[eeaddress&0x1FF];
  }
  return 0xFF;
}
}




ISR(TIMER0_COMPA_vect){    //Video interrupt. This is called at every line in the frame.
  byte c=8;  //Back porch
  byte d=4;  //Left Blank
  byte p=22; //Chars per row
  PORTD=0;
    if ((scanline>2)&&(scanline<40)||(scanline>231)) {
    SYNCDELAY
    PORTD = SYNCPIN;
    VBE=0;
  }

 if (scanline<3) {
    SYNCDELAY   
    PORTD =0;
    videoptr=0;   
    row=0;    
  }  
  
  if ((scanline>39)&&(scanline<232)) {
    SYNCDELAY   
    PORTD = SYNCPIN;
    if (lace&1|INTERLACE) {
    const register byte * linePtr = &charROM [ row & 0x07 ] [0];
    register byte * messagePtr = (byte *) & videomem [videoptr] ;
    while (c--) { 
     asm("nop\n");
     asm("nop\n");
    }   
    UCSR0B = _BV(TXEN0);
    while (d--) { 
     while ((UCSR0A & _BV (UDRE0)) == 0) {}
     UDR0 = 0;
    }
    while (p--) {
     UDR0 = pgm_read_byte (linePtr + (* messagePtr++));
     while ((UCSR0A & _BV (UDRE0)) == 0)
      {}
    }  
    while ((UCSR0A & _BV (UDRE0)) == 0)
      {}  
    UCSR0B = 0;
    row++;
    videoptr=(row>>3)*22;
    VBE=1;
    }
  }
  scanline++;
  if (scanline>LINES) {
    scanline=0;
    lace++;
  } 
}

void setup () {
  pinMode (MSPIM_SS, OUTPUT);  //A must for MSMSPI VIDEO to work
  pinMode (MSPIM_SCK, OUTPUT); //A must for MSMSPI VIDEO to work
  pinMode(2, OUTPUT); //Set D2 as output for Sync. A must for MSMSPI VIDEO to work
  UBRR0 = 0;
  UCSR0A = _BV (TXC0);
  UCSR0C = _BV (UMSEL00) | _BV (UMSEL01);
  UCSR0B = _BV (TXEN0);
  UBRR0 = DOTCLK; 
  cli();
  TCCR0A = 0;
  TCCR0B = 0;
  TCNT0  = 0;
  OCR0A = HSYNC;// = (16*10^6) / (15625*8) - 1 (must be <256)  
  TCCR0A |= (1 << WGM01);
  TCCR0B |= (1 << CS01) | (0 << CS00);   
  TIMSK0 |= (1 << OCIE0A);
  set_sleep_mode (SLEEP_MODE_IDLE);
  sei();

  pinMode(13, OUTPUT);
  digitalWrite(13,LOW);
  pinMode(1, OUTPUT); //A must for MSMSPI VIDEO to work
  digitalWrite(1,LOW); //A must for MSMSPI VIDEO to work
  reset6502();
  for (int i=0;i<528;i++) {
    videomem[i]=32;
  }
}

void loop () {
  WAIT_VBE
  exec6502();
  RAM[55]=0; //POKE55,0
  RAM[56]=0x0A; //POKE56,10 lower top of mem to 0x0A
}

